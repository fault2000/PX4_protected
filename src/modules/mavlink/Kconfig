## src/modules/mavlink/Kconfig
```kconfig
menuconfig MODULES_MAVLINK
	bool "mavlink"
	default n
	---help---
		Enable support for mavlink

menuconfig MAVLINK_DIALECT
depends on MODULES_MAVLINK
        string "Mavlink dialect"
        default "common"
	---help---
		Select the Mavlink dialect to generate and use.

config MAVLINK_MISSION
	bool "MAVLink mission protocol support"
	default y
	depends on MODULES_MAVLINK
	---help---
		Include the mission manager and its dataman client. Disable this for
		communication-only configurations without a running dataman service.
		Mission, fence and rally transfers are unavailable when disabled.

menuconfig MAVLINK_UAVCAN_PARAMETERS
depends on MODULES_MAVLINK && DRIVERS_UAVCAN
        bool "Mavlink UAVCAN parameter support"
        default y
	---help---
		Expose UAVCAN parameters over Mavlink.

menuconfig USER_MAVLINK
	bool "mavlink running as userspace module"
	default y
	depends on BOARD_PROTECTED && MODULES_MAVLINK
	---help---
		Put mavlink in userspace memory
```

## src/systemcmds/hrt_smoke/Kconfig
```kconfig
menuconfig SYSTEMCMDS_HRT_SMOKE
	bool "hrt_smoke"
	default n
	depends on BOARD_PROTECTED && PLATFORM_NUTTX && BOARD_ARCHITECTURE = "cortex-m7"
	---help---
		Bounded HRT callback and cancellation checks for protected userspace.

config USER_HRT_SMOKE
	bool
	default y
	depends on BOARD_PROTECTED && SYSTEMCMDS_HRT_SMOKE
	---help---
		Run hrt_smoke in userspace memory.
```

## src/systemcmds/uorb_smoke/Kconfig
```kconfig
menuconfig SYSTEMCMDS_UORB_SMOKE
	bool "uorb_smoke"
	default n
	depends on BOARD_PROTECTED && PLATFORM_NUTTX && BOARD_ARCHITECTURE = "cortex-m7"
	---help---
		Bounded protected uORB copy, poll, callback and user work queue checks.

config USER_UORB_SMOKE
	bool
	default y
	depends on BOARD_PROTECTED && SYSTEMCMDS_UORB_SMOKE
	---help---
		Run uorb_smoke in userspace memory.
```

## src/systemcmds/uorb_smoke_kernel/Kconfig
```kconfig
menuconfig SYSTEMCMDS_UORB_SMOKE_KERNEL
	bool "uorb_smoke_kernel"
	default n
	depends on BOARD_PROTECTED && PLATFORM_NUTTX && BOARD_ARCHITECTURE = "cortex-m7"
	---help---
		Kernel companion for the fixed uorb_smoke topic round-trip check.
		Invoked through the existing kernel builtin launcher; not a user app.
```

## src/systemcmds/uorb_wait_kernel/Kconfig
```kconfig
menuconfig SYSTEMCMDS_UORB_WAIT_KERNEL
	bool "uorb_wait_kernel"
	default n
	depends on BOARD_PROTECTED && PLATFORM_NUTTX && BOARD_ARCHITECTURE = "cortex-m7"
	---help---
		Fixed kernel observer and producer for uorb_wait_smoke.
		Observes only the invoking task's normal semaphore wait and publishes
		only sequential diagnostic samples on orb_test instance zero.
```

## src/systemcmds/uorb_wait_smoke/Kconfig
```kconfig
menuconfig SYSTEMCMDS_UORB_WAIT_SMOKE
	bool "uorb_wait_smoke"
	default n
	depends on BOARD_PROTECTED && PLATFORM_NUTTX && BOARD_ARCHITECTURE = "cortex-m7"
	---help---
		Bounded protected uORB poll and blocking subscription wait checks.

config USER_UORB_WAIT_SMOKE
	bool
	default y
	depends on BOARD_PROTECTED && SYSTEMCMDS_UORB_WAIT_SMOKE
	---help---
		Run uorb_wait_smoke in userspace memory.
```

## src/systemcmds/work_queue_smoke/Kconfig
```kconfig
menuconfig SYSTEMCMDS_WORK_QUEUE_SMOKE
	bool "work_queue_smoke"
	default n
	depends on BOARD_PROTECTED && PLATFORM_NUTTX && BOARD_ARCHITECTURE = "cortex-m7"
	---help---
		Bounded user work queue scheduling, stop, restart and cleanup checks.

config USER_WORK_QUEUE_SMOKE
	bool
	default y
	depends on BOARD_PROTECTED && SYSTEMCMDS_WORK_QUEUE_SMOKE
	---help---
		Run work_queue_smoke in userspace memory.
```
